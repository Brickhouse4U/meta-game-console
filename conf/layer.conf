## conf/layer.conf
```bitbake
BBPATH .= ":${LAYERDIR}"
BBFILES += "${LAYERDIR}/recipes-*/*/*.bb \
            ${LAYERDIR}/recipes-*/*/*.bbappend"
BBFILE_COLLECTIONS += "game-console"
BBFILE_PATTERN_game-console = "^${LAYERDIR}/"
BBFILE_PRIORITY_game-console = "10"
LAYERDEPENDS_game-console = "core"
LAYERSERIES_COMPAT_game-console = "scarthgap"
```
